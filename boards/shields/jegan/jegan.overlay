// This file was generated from a template. Edit it to match your keyboard.
// See https://zmk.dev/docs/development/hardware-integration/new-shield for more
// instructions.

#include "jegan.dtsi"

&kscan {
    // Replace these comments with the GPIO pins in the matrix for the left side.
    // See https://zmk.dev/docs/development/hardware-integration/new-shield#shield-overlays
    col-gpios
        = <&gpio0 10 GPIO_ACTIVE_HIGH> // D16
        , <&gpio0  9 GPIO_ACTIVE_HIGH> // D10
        , <&gpio1  6 GPIO_ACTIVE_HIGH> // D9
        , <&gpio1  4 GPIO_ACTIVE_HIGH> // D8
        , <&gpio0 11 GPIO_ACTIVE_HIGH> // D7
        , <&gpio1  0 GPIO_ACTIVE_HIGH> // D6
        , <&gpio0 24 GPIO_ACTIVE_HIGH> // D5
        ;

    row-gpios
        = <&gpio0 31 (GPIO_ACTIVE_HIGH | GPIO_PULL_DOWN)> // D21
        , <&gpio0 29 (GPIO_ACTIVE_HIGH | GPIO_PULL_DOWN)> // D20
        , <&gpio0  2 (GPIO_ACTIVE_HIGH | GPIO_PULL_DOWN)> // D19
        , <&gpio1 15 (GPIO_ACTIVE_HIGH | GPIO_PULL_DOWN)> // D18
        , <&gpio1 13 (GPIO_ACTIVE_HIGH | GPIO_PULL_DOWN)> // D15
        , <&gpio1 11 (GPIO_ACTIVE_HIGH | GPIO_PULL_DOWN)> // D14
        ;
};
