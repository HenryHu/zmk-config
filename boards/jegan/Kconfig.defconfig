## boards/shields/jegan/Kconfig.defconfig
```kconfig
if SHIELD_JEGAN_LEFT

config ZMK_KEYBOARD_NAME
    default "jegan"

config ZMK_SPLIT_ROLE_CENTRAL
    default y

config ZMK_DISPLAY
    default y

config ZMK_DISPLAY_BLANK_ON_IDLE
    default y

choice ZMK_DISPLAY_STATUS_SCREEN
    default ZMK_DISPLAY_STATUS_SCREEN_CUSTOM
endchoice

choice ZMK_DISPLAY_WORK_QUEUE
    default ZMK_DISPLAY_WORK_QUEUE_DEDICATED
endchoice

endif # SHIELD_JEGAN_LEFT

if SHIELD_JEGAN_LEFT || SHIELD_JEGAN_RIGHT

config ZMK_SPLIT
    default y

#### Underglow settings

config ZMK_RGB_UNDERGLOW
    default y

config ZMK_RGB_UNDERGLOW_AUTO_OFF_USB
    default y

config ZMK_RGB_UNDERGLOW_ON_START
    default y

config ZMK_RGB_UNDERGLOW_EFF_START
    default 3

config LED_STRIP
    default y

config WS2812_STRIP
    default y

choice WS2812_STRIP_DRIVER
    default WS2812_STRIP_SPI
endchoice

config ZMK_RGB_UNDERGLOW_BRT_START
    default 20

#### Sleep / power save settings

config ZMK_SLEEP
    default y

config ZMK_PM_SOFT_OFF
    default y

config ZMK_IDLE_SLEEP_TIMEOUT
    default 300000

#### Display settings

if ZMK_DISPLAY

# Do not turn off ext-power of there's a display, as display
# also relies on that. Otherwise, we can turn ext-power off
# to save power - RGB leds consume a lot of power, even if
# they're off.
config ZMK_RGB_UNDERGLOW_EXT_POWER
    default n

endif

if LVGL

config LV_Z_VDB_SIZE
    default 64

config LV_DPI_DEF
    default 148

config LV_Z_BITS_PER_PIXEL
    default 1

choice LV_COLOR_DEPTH
    default LV_COLOR_DEPTH_1
endchoice

endif # LVGL

endif # SHIELD_JEGAN_LEFT || SHIELD_JEGAN_RIGHT
```

## boards/shields/jegan/Kconfig.shield
```kconfig
#config SHIELD_JEGAN_LEFT
#    def_bool $(shields_list_contains,jegan_left)
#
#config SHIELD_JEGAN_RIGHT
#    def_bool $(shields_list_contains,jegan_right)
config SHIELD_JEGAN
    def_bool $(shields_list_contains,jegan)
```
